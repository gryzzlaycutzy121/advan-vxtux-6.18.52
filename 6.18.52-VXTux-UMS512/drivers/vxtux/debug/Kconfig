## 6.18.52-VXTux-UMS512/drivers/vxtux/debug/Kconfig
```kconfig
# SPDX-License-Identifier: GPL-2.0
#
# drivers/vxtux/debug/Kconfig - boot diagnostics for UMS512 (VXTux)
#
# Note: kernel messages themselves are English only.  Any text these
# options put on the panel must stay English too, so that a boot log from
# this device reads like a boot log from any other Linux machine.

config VXTUX_LKFB
	bool "Register the bootloader framebuffer as an fbdev (console on panel)"
	depends on VXTUX_DRIVERS
	depends on FB
	depends on FRAMEBUFFER_CONSOLE
	select FB_CFB_FILLRECT
	select FB_CFB_COPYAREA
	select FB_CFB_IMAGEBLIT
	# fb_io_read/fb_io_write/fb_io_mmap come from FB_DEFAULT_IOMEM_OPS,
	# which is only built by fb_io_fops.o; without this the vmlinux link
	# fails with "undefined reference to fb_io_read" (CI 40322990302).
	select FB_IOMEM_FOPS
	help
	  Register the framebuffer the display controller already scans out
	  (lcd_base=0x9e000000, 1200x2000, RGB565) as an fbdev device, so
	  fbcon attaches to it and every console=tty0 message lands on the
	  panel.

	  Without this, console=tty0 writes to a virtual console with no
	  display: the tree has no CONFIG_FB_SIMPLE (the stock device tree
	  has no simple-framebuffer node, and LK builds its own DTB) and the
	  SPRD DRM DPU never probes, so the panel would sit on the LK splash
	  image even after the kernel has booted far.

	  The driver wipes the panel and then replays the last 200 dmesg
	  lines, so the console starts clean and shows what happened before
	  fbcon was available.

	  The framebuffer memory is reserved by the early_param
	  vxtuxfb=<phys>,... in vxtux_beacon.c.  Default n; enable it when
	  chasing boot problems.

config VXTUX_BEACON
	bool "Keep the bootloader framebuffer memory out of the buddy allocator"
	depends on PRINTK
	help
	  LK leaves the panel scanning out of two buffers (0x9d000000 and
	  0x9e000000) that the stock device tree does not reserve.  This
	  option claims them in an early_param (vxtuxfb=...), while memblock
	  can still be edited, so the buddy allocator can never hand those
	  pages to anyone else and scribble over the console.

	  This file used to also draw a debug beacon - one white box per
	  initcall level, plus a red bar on panic.  That drawing path is
	  gone: the framebuffer console and its dmesg replay replaced it, and
	  the boxes made the handover from LK to the kernel look dirty.

	  Default n; required whenever VXTUX_LKFB is enabled.

config VXTUX_INITTRACE
	bool "Paint every initcall on the bootloader framebuffer"
	depends on VXTUX_DRIVERS
	depends on VXTUX_BEACON
	depends on FONT_SUPPORT
	depends on KALLSYMS
	help
	  Diagnostic for boots that freeze before fbcon exists (artix36:
	  LK starts the kernel, then the panel stays on the LK warning text
	  forever - no panic, no reboot, no eMMC write, nothing in cache).

	  Each initcall's symbol name is drawn on the LK panel (lcd_base
	  0x9e000000, reserved by VXTUX_BEACON) BEFORE the initcall runs,
	  using the built-in VGA8x16 font through the linear map.  When the
	  boot hangs, the last line on screen IS the initcall that hung.
	  vxtux_lkfb calls vxtux_itrace_stop() when fbcon takes over the
	  panel, so the two never fight over the screen.

	  Default n; enable only while chasing a boot hang.

config VXTUX_LOGREC
	bool "Reset-proof boot log recorder (cache slots + RAM record)"
	depends on PRINTK
	depends on BLOCK
	help
	  Rekam log kernel (dmesg) ke partisi cache (mmcblk0p49) secara
	  berkala, dengan jaminan byte benar-benar sampai ke eMMC, lalu simpan
	  juga salinannya di region RAM yang direserve supaya boot yang mati
	  sebelum driver MMC probe tetap meninggalkan jejak.

	  Kenapa perlu: pendahulunya (VXTUX_FLIGHTREC) memverifikasi tulisannya
	  dengan membaca balik lewat page cache, sehingga melaporkan "write OK"
	  padahal tidak ada satu byte pun di eMMC.  AP di perangkat ini mati oleh
	  watchdog sekitar detik ke-30, jauh sebelum writeback 30 detik jalan -
	  itulah sebab 28 dump cache (artix6..artix33) byte-identik.

	  Bedanya dengan VXTUX_FLIGHTREC:
	    * vfs_fsync() setelah setiap tulisan (sync_blockdev + FLUSH eMMC),
	    * verifikasi dilakukan setelah invalidate_inode_pages2(), jadi yang
	      dibaca balik adalah isi disk, bukan page cache,
	    * 8 slot x 4 MiB bergilang -> riwayat 8 snapshot terakhir, bukan
	      hanya cuplikan terakhir,
	    * record RAM (cmdline vxtuxlog=<phys>) dipanen boot berikutnya dan
	      ikut ditulis ke eMMC dengan reason=PREVBOOT,
	    * status ringkas di /proc/vxtuxlog.

	  Tata letak dan cara membaca: lihat kepala vxtux_logrec.c serta
	  out/tools/baca_logrec.py.  Aktifkan hanya saat mengejar masalah boot,
	  karena driver ini menulis eMMC terus-menerus.

config VXTUX_HOOK
	  bool "Trace hook resource API + regmap (deblob compare)"
	  depends on VXTUX_DRIVERS
	  depends on KPROBES
	  depends on KALLSYMS
	  help
	  Kprobe pada resource API (clk/regulator/reset/pinctrl/irq/dma/
	  ioremap/platform_driver_register/driver_probe_device/dev_pm_domain)
	  dan regmap (regmap_write/read/update_bits_base) untuk menangkap
	  kontrak software driver (permintaan resource, nilai register,
	  urutan probe/defer) ke ring RAM yang di-reserve (cmdline
	  vxtuxtrace=<phys>, default 0xAF800000) yang tahan reset.

	  Kegunaan: membandingkan perilaku driver stok 5.4.210 (golden)
	  dengan port 6.18.52 (replay) lewat spd_dump read_mem + vxtr_parse.py.
	  Baca juga drivers/vxtux/debug/vxtux_hook.c (koreksi desain: regmap
	  bukan mmiotrace yang tidak ada di arm64, bukan kprobe readl/writel
	  yang inline macro).

config VXTUX_FLIGHTREC
	bool "Record the boot log to the cache partition (deprecated: pakai VXTUX_LOGREC)"
	depends on PRINTK
	depends on BLOCK
	# Dua penulis ke offset yang sama hanya akan saling menimpa; VXTUX_LOGREC
	# adalah penggantinya (fsync + verifikasi dari disk + 8 slot + record RAM).
	depends on !VXTUX_LOGREC
	help
	  Copy the kernel log buffer (dmesg) to the cache partition
	  (mmcblk0p49, offset 8 MiB) every ~3 seconds from a kthread, and
	  once more on panic.

	  Why: a boot that hangs before userspace leaves no trace at all -
	  the panel sits on the LK splash, there is no panic, and the cache
	  partition stays empty.  With this recorder the last initcall that
	  ran is still on disk (the command line sets initcall_debug=1) and
	  can be read by dumping the cache partition.

	  Records are marked with the magic "VXTUXFR1".  Default n; enable it
	  only when chasing boot problems, since it writes to eMMC
	  continuously.

config VXTUX_BLDB
	bool "BLDB early debug ring (/dev/bldb0, Berry Lab Foundation)"
	depends on PRINTK
	# TANPA depends on MISC_DEVICES: simbol itu sudah tidak ada lagi di tree
	# 6.18 ini dan drivers/char/Makefile membangun misc.o sebagai obj-y,
	# jadi misc_register() selalu tersedia.  depends ke simbol hantu membuat
	# olddefconfig membuang CONFIG_VXTUX_BLDB=y dan guard CI gagal.
	default n
	help
	  Berry Linux Debug Bridge: a 16 MiB static printk ring plus the
	  misc device /dev/bldb0, started from core_initcall so it captures
	  the boot from the very first message.

	  The userspace daemon bldbd relays the ring to the PC over the USB
	  gadget serial port (configfs ACM) and feeds commands back
	  (stats/clear/mark/peek32/poke32), giving a two-way debug door that
	  needs no soldering and survives as long as the kernel does.

	  peek32/poke32 only touch RAM the kernel considers valid and never
	  the kernel text or the ring itself.  See the header of
	  drivers/vxtux/debug/bldb_core.c for the full ring-0 mitigation list.

	  Original work of Berry Lab Foundation (Berry Foundation Public v1
	  - MIT, GPL-compatible); no Unisoc/Spreadtrum code involved.
```

## 6.18.52-VXTux-UMS512/drivers/vxtux/soc/autotest/Kconfig
```kconfig
# SPDX-License-Identifier: GPL-2.0
config SPRD_AUTOTEST
	tristate "Spreadtrum autotest framework (core)"
	depends on ARM64
	help
	  Char device "autotest0" dalam class "autotest" (10 minor) yang
	  meneruskan ioctl ke handler terdaftar berdasarkan cmd.  Modul lain
	  mendaftar lewat sprd_autotest_register_handler(); cmd duplikat
	  ditolak dengan -EEXIST.

	  Port dari blob vendor 5.4 `core.ko`.

config SPRD_AUTOTEST_GPIO
	tristate "Spreadtrum autotest GPIO handler"
	depends on SPRD_AUTOTEST && GPIOLIB
	help
	  Handler cmd 0xc0044101 (_IOWR('A', 1, 4)): argumen u32 dari user
	  berisi offset (bit 0..15), dir (bit 16), value (bit 17).  Chip
	  dipilih dengan ngpio == 256; arah input membaca nilai line dan
	  menulis balik bit 17.

	  Port dari blob vendor 5.4 `gpio.ko`.

config SPRD_AUTOTEST_PINCTRL
	tristate "Spreadtrum autotest pinctrl handler"
	depends on SPRD_AUTOTEST && PINCTRL
	help
	  Handler cmd 0xc0044100 (_IOWR('A', 0, 4)): argumen ioctl berupa
	  pointer ke u32 gpio index.  State pinctrl "gpio_%d" dicari lewat
	  pinctrl_lookup_state() lalu dipilih dengan pinctrl_select_state().
	  Node DT "sprd,autotest" dengan phandle "sprd,pinctrl" dipakai
	  saat register (handler->init).

	  Port dari blob vendor 5.4 `pinctrl.ko`.
```
